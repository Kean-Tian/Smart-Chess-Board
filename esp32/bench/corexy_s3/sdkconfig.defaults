## esp32/bench/corexy_s3/sdkconfig.defaults
```kconfig
CONFIG_IDF_TARGET="esp32s3"
CONFIG_ESPTOOLPY_FLASHMODE_DIO=y
CONFIG_ESPTOOLPY_FLASHFREQ_40M=y
CONFIG_ESPTOOLPY_FLASHSIZE_16MB=y
CONFIG_FREERTOS_HZ=1000
CONFIG_ESP_CONSOLE_NONE=y
CONFIG_LOG_DEFAULT_LEVEL_NONE=y
CONFIG_BOOTLOADER_LOG_LEVEL_NONE=y
CONFIG_ESP_MAIN_TASK_STACK_SIZE=8192
```

## esp32/bench/gpio_a0_high/sdkconfig.defaults
```kconfig
CONFIG_IDF_TARGET="esp32s3"
CONFIG_ESPTOOLPY_FLASHMODE_DIO=y
CONFIG_ESPTOOLPY_FLASHFREQ_40M=y
CONFIG_ESPTOOLPY_FLASHSIZE_16MB=y
CONFIG_SPIRAM=n
CONFIG_FREERTOS_UNICORE=n
CONFIG_ESP_CONSOLE_NONE=y
CONFIG_BOOTLOADER_LOG_LEVEL_NONE=y
CONFIG_LOG_DEFAULT_LEVEL_NONE=y
```

## esp32/components/board_logic/Kconfig.projbuild
```kconfig
menu "SCB PCB V3 wiring"
config SCB_SENSOR_NAMED_WIRING
    bool "Sensor cable is crossed by signal NAME rather than pin number"
    default n
    help
        Default IDC16 pin n to pin n: sensor A0/A1/A2 use GPIO10/9/8.
        Master MUX_IN1/3 names occupy opposite contacts from sensor MUX_IN1/3.
        Enable ONLY for a verified name-crossed cable (sensor A0/A1/A2=8/9/10).
endmenu
```

## esp32/components/scb_transport/Kconfig.projbuild
```kconfig
menu "SCB local communication"
choice SCB_LINK_TRANSPORT
    prompt "Application protocol transport"
    default SCB_LINK_USB
config SCB_LINK_USB
    bool "J5 native USB Serial/JTAG (GPIO19/20)"
config SCB_LINK_UART
    bool "J6 wired 3.3 V UART1 (TX GPIO17, RX GPIO18)"
endchoice
endmenu
```
